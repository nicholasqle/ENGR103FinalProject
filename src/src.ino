#include <Adafruit_CircuitPlayground.h>
int arraySize, wrongGuesses, currentReading, score, touchedPad; //initialize variables used for gameplay
bool gameRunning, padTouched; //status bools for gameplay 
bool ResetFlag=0; //Flag for reset button interrupt
bool FinishFlag=0; //Flag for finish button interrupt
const byte interruptButtonLeft = 4; //Assign left button
const byte interruptButtonRight = 5; //Assign right button
int pads[] = {6, 9, 10, 3, 2, 0, 1}; //Converts analog pin number to digital pin for A1 to A7.
int numbers[10]; //Array where random numbers will be stored

//The below speech was pulled from the Speech_Demos located in Adafruit Circuit Playground library. The original credits are as follows:
// Talkie library
// Copyright 2011 Peter Knight
// This code is released under GPLv2 license.
//
const uint8_t spONE[]       PROGMEM = {0xCC,0x67,0x75,0x42,0x59,0x5D,0x3A,0x4F,0x9D,0x36,0x63,0xB7,0x59,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0xFF,0x0F};
const uint8_t spTWO[]       PROGMEM = {0x0E,0x38,0x6E,0x25,0x00,0xA3,0x0D,0x3A,0xA0,0x37,0xC5,0xA0,0x05,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0xFF,0x0F};
const uint8_t spTHREE[]     PROGMEM = {0x02,0xD8,0x2E,0x9C,0x01,0xDB,0xA6,0x33,0x60,0xFB,0x30,0x01,0xEC,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0xFF,0x0F};
const uint8_t spFOUR[]      PROGMEM = {0x0C,0x18,0xB6,0x9A,0x01,0xC3,0x75,0x09,0x60,0xD8,0x0E,0x09,0x30,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0xFF,0x07};
const uint8_t spFIVE[]      PROGMEM = {0x02,0xE8,0x3E,0x8C,0x01,0xDD,0x65,0x08,0x60,0x98,0x4C,0x06,0x34,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0xFE,0x7F};
const uint8_t spSIX[]       PROGMEM = {0x0E,0xD8,0xAE,0xDD,0x03,0x0E,0x38,0xA6,0xD2,0x01,0xD3,0xB4,0x2C,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0xFC,0x3F};
const uint8_t spSEVEN[]     PROGMEM = {0x02,0xB8,0x3A,0x8C,0x01,0xDF,0xA4,0x73,0x40,0x01,0x47,0xB9,0x2F,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0xF3,0xFF};
//End of speech
//

void setup() {
  // put your setup code here, to run once:
  Serial.begin(9600);
  CircuitPlayground.begin();
  pinMode(interruptButtonLeft, INPUT);
  pinMode(interruptButtonRight, INPUT);
  attachInterrupt(digitalPinToInterrupt(interruptButtonLeft),AbuttonISR,RISING);
  attachInterrupt(digitalPinToInterrupt(interruptButtonRight),BbuttonISR,RISING);
  arraySize = 1;
  arrayGenerator(arraySize);
  arrayReader();
}

void loop() {
  // put your main code here, to run repeatedly:
  //resets the game
  if (ResetFlag){
    delay(5);
    Serial.println("Game Reset");
    arraySize=1;
    currentReading = 0;
    wrongGuesses = 0;
    score=0;
    ResetFlag=0;
    gameRunning = 1;
    CircuitPlayground.clearPixels();
    arrayReader();
  }
  //Quits the game
  else if (FinishFlag){
    Serial.println("Quit Game");
    delay(5);
    gameRunning = 0;
    FinishFlag = 0;
    gameOver();
  }
//This is the main game logic code
      do{
        //Too many wrong guesses ends the game
        if (wrongGuesses==3){
          Serial.println("Too many wrong guesses");
          gameOver();
        }
        //Game is won if 10 numbers are correctly guessed in the 10th round
        else if (arraySize==11){
          Serial.println("More than 10 numbers guessed!");
          gameOver();
        }
        //exits the main game if finish or reset button is pressed
        else if (FinishFlag || ResetFlag){
          break;
        }
        //if a pad is touched, it is checked to see if it is the correct one.
        else if (padTouched){
          if (touchedPad==numbers[currentReading]){
            //correct press
            Serial.println("Correct");
            for (int i =0; i<10; i++){
              CircuitPlayground.setPixelColor(i, 0, 255, 0);
            }
            delay(500);
            currentReading += 1; //goes to the next number in the sequence
            wrongGuesses = 0;
            padTouched = 0;
            CircuitPlayground.clearPixels();
          }  
          else{
            //incorrect press
            Serial.println("Incorrect");
            for (int i =0; i<10; i++){
              CircuitPlayground.setPixelColor(i, 255, 0, 0);
            }
            delay(500);
            wrongGuesses += 1;
            if (wrongGuesses<3){arrayReader();}
            padTouched = 0;
            currentReading = 0;
            CircuitPlayground.clearPixels();
          }
        }
        // generates new number sequence after all numbers in corrent sequence are correct
        else if (currentReading > (arraySize-1)){
          score = arraySize;
          arraySize += 1;
          arrayGenerator(arraySize);
          currentReading = 0;
          if (arraySize<11){arrayReader();}
        }
        //Checks if a pad is touched
        else{
          for (int i=0; i<7; i++){
            if (CircuitPlayground.readCap(pads[i])>900){
            touchedPad = i+1; //registers what number was touched
            padTouched = 1; //sets flag that a pad was touched
            Serial.println("Touch Registered");
            Serial.println(touchedPad);
            }
          }
        }



      }
      while(gameRunning);








}














//function generates a random number sequence of certain size.
void arrayGenerator(int arraySize) {
  for (int i = 0; i < arraySize; i++) {
    randomSeed(analogRead(A0));
    numbers[i] = random(1, 7);
  }
}

//function goes through the sequence of numbers and reads it out loud using speech.
void arrayReader(){
  for (int i = 0; i < arraySize; i++) {
    switch(numbers[i]){
      case 1:
      CircuitPlayground.speaker.say(spONE);
      break;

      case 2:
      CircuitPlayground.speaker.say(spTWO);
      break;

      case 3:
      CircuitPlayground.speaker.say(spTHREE);
      break;

      case 4:
      CircuitPlayground.speaker.say(spFOUR);
      break;

      case 5:
      CircuitPlayground.speaker.say(spFIVE);
      break;

      case 6:
      CircuitPlayground.speaker.say(spSIX);
      break;

      case 7:
      CircuitPlayground.speaker.say(spSEVEN);
      break;


    }
    delay(500);
  }
}

//if the game ends for any reason, the score is indicated using the LEDs
void gameOver(){
  gameRunning=0;
  Serial.println("Game Over");
  //If the game is not fully complete, RED LEDs show the score.
  if (score<10){
    for (int i =0; i<score; i++){
      CircuitPlayground.setPixelColor(i, 255, 0, 0);
      delay(200);
    }
  }
  //If the game is won, all GREEN LEDs are lit
  else if (score>9){
    for (int i =0; i<10; i++){
      CircuitPlayground.setPixelColor(i, 0, 255, 0);
      delay(200);
    }
  }

  //Add score Reader Later
}

void AbuttonISR(){
ResetFlag = 1;
}

void BbuttonISR(){
FinishFlag = 1;
}